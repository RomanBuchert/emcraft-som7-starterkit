MEMORY
{
	rom (rx) : ORIGIN = ${LCD_TEST_FLASH_START}, LENGTH = ${LCD_TEST_FLASH_SIZE}
	ram (rwx) : ORIGIN = ${LCD_TEST_IRAM_START}, LENGTH = ${LCD_TEST_IRAM_SIZE}
	xram(rwx) : ORIGIN = ${LCD_TEST_XRAM_START}, LENGTH = ${LCD_TEST_XRAM_SIZE}
}

INCLUDE ${LIBOPENCM3_LINKERSCRIPT}

